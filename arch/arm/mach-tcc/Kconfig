## arch/arm/mach-tcc/Kconfig
```kconfig
config ARCH_TCC
	bool "Telechips" if (ARCH_MULTI_V7 || ARCH_MULTI_V6 || ARCH_MULTI_V6_V7)
	select ARCH_HAS_CPUFREQ
	select ARCH_REQUIRE_GPIOLIB
	select GENERIC_IRQ_CHIP
	select CLKDEV_LOOKUP
	select CLKSRC_MMIO
	select CLKSRC_OF
	select COMMON_CLK
	select GENERIC_CLOCKEVENTS
	select HAVE_CLK
	select SOC_BUS
	select SPARSE_IRQ
	select USE_OF
	select PINCTRL
	select PINCTRL_TCC
	select HAVE_TCM
	help
	  This enables support for Telechips based systems.

menu "Telechips options"
	depends on ARCH_TCC

config SOC_TCC92XX
	bool "TCC890x/TCC920x" if (ARCH_MULTI_V6 || ARCH_MULTI_V6_V7)
	select CPU_V6
	select VIRT_TO_BUS
	help
	  Support for the Telechips TCC890x & TCC920x ARM1176JZF-S based processors.

config SOC_TCC88XX
	bool "TCC880x" if (ARCH_MULTI_V7 || ARCH_MULTI_V6_V7)
	select CPU_V7
	select VIRT_TO_BUS
	help
	  Support for the Telechips TCC880x Cortex-A8 based processors.

endmenu
```

## arch/arm/mach-tcc892x/Kconfig
```kconfig
if ARCH_TCC892X

choice
	prompt "TCC892x Board(Machine) Type"
	default MACH_TCC8920
	depends on ARCH_TCC892X
	help
	  Select TCC892x board type.

config MACH_TCC8920
	bool "TCC8920 evaluation board"
	help
	  Support for the TCC8920 evaluation board. Say Y here if you
	  have such a device.

config MACH_TCC8920ST
	bool "TCC8920 STB evaluation board"
	help
	  Support for the TCC8924 evaluation board. Say Y here if you
	  have such a device.

config MACH_M805_892X
	bool "M805_TCC8923 board"
	help
	  Support for the TCC8923 M805 board. Say Y here if you
	  have such a device.
endchoice

choice
	prompt "M805S_TCC892x Chipset Type"
	default TCC8923_0XA
	depends on MACH_M805_892X
	help
	  Select M805S_TCC892x Chipset type.

config M805S_8923_0XX
	bool "TCC8923_0XX Chipset"
	depends on MACH_M805_892X
	help
	  Support for the TCC8923-0XX chipset.

config M805S_8923_0XA
	bool "TCC8923_0XA Chipset"
	depends on MACH_M805_892X
	help
	  Support for the TCC8923-0XA chipset.

config M805S_8925_0XX
	bool "TCC8925_0XX Chipset"
	depends on MACH_M805_892X
	help
	  Support for the TCC8925-0XX chipset.
endchoice
	  
choice
	prompt "TCC892x STB Board"
	default STB_BOARD_EV
	depends on MACH_TCC8920ST
	help
	  Select TCC892x STB Board Type.

config STB_BOARD_EV
	bool "TCC8920 STB evalution board"
	depends on MACH_TCC8920ST
	help
	  Support for TCC8920 STB Base Board.

config STB_BOARD_HDB892S
	bool "TCC8920 HDB892S board"
	depends on MACH_TCC8920ST
	help
	  Support for TCC8920 HD892S Board.

config STB_BOARD_DONGLE
	bool "TCC8925 HDMI dongle board"
	depends on MACH_TCC8920ST
	help
	  Support for TCC8925 HDMI Dongle Board.
endchoice

config CPU_HIGHSPEED
    bool "CPU high-speed clock"
    depends on ARCH_TCC892X
    default n
    help
     Support for the TCC892x demo board, Say Y here if you
     want to overclocking

config GPIO_CORE_VOLTAGE_CONTROL
	bool "Ctrl coreA/B voltage by gpio ports"
	depends on CPU_FREQ_DEFAULT_GOV_ONDEMAND && !REGULATOR
	default n
	help
	  Support for the TCC892X demo board.

config TCC_STB_MODE
	bool "TCC STB Mode"
        default n
	help
	  Support for the TCC93/88/8920 demo board, Say Y here if you STB
	  It change the memory configuration

config TCC_OUTPUT_STARTER
        bool "TCC OUTPUT show boot logo image on HDMI/CVBS/Component"
        depends on ARCH_TCC892X
        default n
        help
          Support for the TCC93/88/8920 demo board, Say Y here if you want
          to show boot logo by using HDMI/CVBS/Component output

endif
```

## arch/arm/mach-tcc92xx/Kconfig
```kconfig
if ARCH_TCC92XX

comment "TCC Board Type"

config MACH_TCC9200S
    bool "TCC9200s evaluation board"
    depends on ARCH_TCC92XX
    help 
      Support for the TCC9200s demo board. Say Y here if you
      have such a device.

config MACH_TCC9201
    bool "TCC9201 evaluation board"
    depends on ARCH_TCC92XX
    help
      Support for the TCC9201 demo board. Say Y here if you
      have such a device.
      
config MACH_TCC8900
    bool "TCC8900 evaluation board"
    depends on ARCH_TCC92XX
    help 
      Support for the TCC8900 demo board. Say Y here if you
      have such a device.

config MACH_M57TE
    bool "M57TE board"
    depends on ARCH_TCC92XX
    help 
      Support for the M57TE board. Say Y here if you
      have such a device.

config MACH_M801
    bool "M801 board"
    depends on ARCH_TCC92XX
    help
      Support for the M801 board. Say Y here if you
      have such a device.

comment "TCC Feature Selections"

config TCC_CHIP_REV_A
    tristate "TCC Chip Revision A - 2009 July"
    help 
      Support for the TCC9200x demo board, Say Y here if you
      have such a Rev.A chip.

config TCC_EHI
    tristate "TCC EHI driver"
    depends on ARCH_TCC92XX
    help 
      Support for the TCC9200x demo board, Say Y here if you
      have such a Rev.A chip.

config HIGH_PERFORMANCE
    bool "High performance"
    depends on DRAM_MDDR && REGULATOR
    help
      Support for the TCC92xx demo board. Say Y here if you
      want high performance.

config CPU_OVERCLOCKING_700MHZ
    bool "CPU overclocking to 700MHz"
    depends on DRAM_MDDR && HIGH_PERFORMANCE
    help
      Support for the TCC92xx demo board. Say Y here if you
      want overclocking.

config CPU_HIGHSPEED
    bool "CPU high-speed clock to 1GHz"
    depends on DRAM_DDR2
    help
     Support for the TCC89/91/92xx demo board, Say Y here if you
     want to overclocking

config VBUS_280MHZ_USE
    bool "Use max VBUS clock to 280MHz (Not enough tested)"
    depends on CPU_HIGHSPEED && TCC_MEM_512MB
    help
     This clock setting can be used for 512MB 1GHz Froyo version to play Full HD video file.
     But this setting is still being tested and please do not use until we confirm its stability

#Bruce_Sleep_ITCM, 100104, PowerDown+ITCMBoot
config SLEEP_WITH_ITCM
	bool "TCC PowerDown mode with ITCM Boot"
    depends on ARCH_TCC92XX
	default y
    help
      Support for the TCC92xx PowerDown + ITCM Boot. Select Y here if you
      want it.

choice
  bool "TCC HDMI UI size"
  default TCC_HDMI_UI_SIZE_800_480
  help
        HDMI UI size for TCC89/91/92 Demo Board

config TCC_HDMI_UI_SIZE_800_480
   bool "TCC hdmi ui size use 800_480"
   help
     Support for the TCC89/91/92xx demo board, Say Y here if you
     want to use 800_480

config TCC_HDMI_UI_SIZE_1280_720
   bool "TCC hdmi ui size use 1280_720"
   help
     Support for the TCC89/91/92xx demo board, Say Y here if you
     want to use 1280_720

endchoice

config TCC_HDMI_STARTER
        bool "TCC HDMI show boot logo image"
        depends on ARCH_TCC92XX
        default n
        help
          Support for the TCC89/91/92xx demo board, Say Y here if you
          want to show boot logo on HDMI

config TCC_OUTPUT_STARTER
        bool "TCC OUTPUT show boot logo image on HDMI/CVBS/Component"
        depends on ARCH_TCC92XX
        default n
        help
          Support for the TCC89/91/92xx demo board, Say Y here if you want
          to show boot logo by using HDMI/CVBS/Component output

config USE_TCC_LAYER
	bool "Support TCC interface layer"
	default n
	help
		TCC interface layer.

config WIFI_CONTROL_FUNC
	bool "Enable WiFi control function abstraction"
	help
	  Enables Power/Reset/Carddetect function abstraction

endif
```

## arch/arm/mach-tcc93xx/Kconfig
```kconfig
if ARCH_TCC93XX

comment "TCC Board Type"

config MACH_TCC9300
	bool "TCC9300 demo board"
	depends on ARCH_TCC93XX
	help
	  Support for the TCC9300 demo board. Say Y here if you have such a device.

config MACH_TCC9300ST
        bool "TCC930X STB demo board"
	depends on ARCH_TCC93XX
        help
          Support for the TCC930X_STB demo board. Say Y here if you have such a device.

config MACH_TCC9300CM
	bool "TCC9300CM demo board"
	depends on ARCH_TCC93XX
	help
	  Support for the TCC9300_89 demo board. Say Y here if you  have such a device.

comment "TCC Feature Selections"

config CPU_HIGHSPEED
    bool "CPU high-speed clock"
    depends on ARCH_TCC93XX
    default n
    help
     Support for the TCC88xx demo board, Say Y here if you
     want to overclocking

config GPIO_CORE_VOLTAGE_CONTROL
	bool "Ctrl coreA/B voltage by gpio ports"
	depends on CPU_FREQ_DEFAULT_GOV_ONDEMAND && !REGULATOR
	default n
	help
	  Support for the TCC88XX demo board.

config WIFI_CONTROL_FUNC
	bool "Enable WiFi control function abstraction"
	help
	  Enables Power/Reset/Carddetect function abstraction

comment "TCC STB Feature Selections"

config TCC_STB_MODE
	bool "TCC STB Mode"
	help
	  Support for the TCC93/88/8910 demo board, Say Y here if you STB
	  It change the memory configuration

config TCC_OUTPUT_STARTER
        bool "TCC OUTPUT show boot logo image on HDMI/CVBS/Component"
        depends on ARCH_TCC93XX
        default n
        help
          Support for the TCC93/88/8910 demo board, Say Y here if you want
          to show boot logo by using HDMI/CVBS/Component output


config USE_TCC_LAYER
        bool "Support TCC interface layer"
        default n
        help
                TCC interface layer.

endif
```

## drivers/i-tv/i-frontend/i-tuner/Kconfig
```kconfig
config iTV_ENABLE_XC5000_MODULE
	tristate "Enable xc5000 tuner module"
	depends on iTV_MODULE

config iTV_ENABLE_FQD1136_MODULE
	tristate "Enable fqd1136 tuner module"
	depends on iTV_MODULE
```

## drivers/video/tcc/Kconfig
```kconfig
config FB_TCC
	bool "Telechips TCC Frame buffer support"
	depends on FB && (ARCH_TCC92XX || ARCH_TCC88XX || ARCH_TCC93XX)
	default y
	select FB_CFB_FILLRECT
	select FB_CFB_COPYAREA
	select FB_CFB_IMAGEBLIT

	help
	  Framebuffer driver for Telechips TCC series.

	  If unsure, say N.

config FB_TCC_USE_VSYNC_INTERRUPT
	bool "Use VSYNC interrupt"
	depends on FB_TCC && FB_TCC

config FB_M2M_COPY
	bool "Use framebuffer copy using m2m-scaler"
	depends on FB_TCC_USE_VSYNC_INTERRUPT
	default n 

config USE_EXT_INTERRUPT
	bool "Use external-vsync-interrupt"
	depends on FB_TCC_USE_VSYNC_INTERRUPT && ARCH_TCC92XX
	default y

	
config TCC_HDMI_DRIVER
	bool "Use TCC HDMI function"
	default y

config FB_TCC93XX
    bool "TCC93xx Frame buffer support"
	depends on FB && ARCH_TCC93XX
	default y
	select FB_CFB_FILLRECT
	select FB_CFB_COPYAREA
	select FB_CFB_IMAGEBLIT

	help
	  Framebuffer driver for Telechips TCC93xx series.

	  If unsure, say N.

config FB_TCC_OVERLAY
	tristate "Overlay for Camera/Video"
	depends on FB && ARCH_TCC
	help
	  This is the Overlay device driver

config FB_TCC_OVERLAY_EXT
	tristate "Overlay_ext for Camera/Video"
	depends on FB && ARCH_TCC
	help
	  This is the Overlay_ext device driver to support 2-channel overlay.

config FB_TCC_COMPOSITE
    tristate "Composite(Y+Pb+Pr) Output for UI/Video"
	depends on FB && ARCH_TCC
	help
	  This is the Composite device driver

config FB_TCC_COMPONENT
    tristate "Component(Y/Pb/Pr) Output for UI/Video"
	depends on FB && ARCH_TCC
	help
	  This is the Component device driver

config TCC_OUTPUT_AUTO_DETECTION
    bool "Auto-Detection of HDMI/Composite/Component Output"
	depends on FB && (MACH_TCC9300ST || MACH_TCC8800ST)
	default n
	help
	  HDMI/Composite/Component output can be detected automatically.

config TCC_VIDEO_DISPLAY_BY_VSYNC_INT
    bool "Displaying video frame by hw vsync interrupt"
	depends on FB && (ARCH_TCC93XX || ARCH_TCC88XX)
	default y
	help
	  Video frame is displayed by hw vsync interrupt.

config TCC_VIDEO_DISPLAY_DEINTERLACE_MODE
    bool "Support Interlaced Video"
	depends on TCC_VIDEO_DISPLAY_BY_VSYNC_INT
	default y
	help
	  It makes the interlaced video can be displayed smoothly.

config TCC_EXCLUSIVE_UI_LAYER
    bool "Exclusive UI Layer for Specific UI"
	depends on FB && (MACH_TCC9300ST || MACH_TCC8800ST)
	default n
	help
	  Video Frame is displayed with Specific UI data.

config TCC_OUTPUT_DUAL_UI
    bool "Dual UI for HDMI/Composite/Component Output"
	depends on FB && MACH_TCC8800ST
	default n
	help
	  Video Frame is displayed with Specific UI data.

config TCC_FB_HIGH_CLOCK
    bool "FB limit clock high"
	depends on FB
	default n
	help
	  FB limit clock chage to high when big size LCD module use.

menu "Support for LCD panels"

config LCD_LMS350DF01
	bool "Samsung LMS350DF01 LCD support"
	depends on FB_TCC

config LCD_LMS480KF01
	bool "Samsung LMS480KF01 LCD support"
	depends on FB_TCC

config LCD_DX08D11VM0AAA
	bool "Hitachi DX08D11VM0AAA LCD support"
	depends on FB_TCC

config LCD_LB070WV6
	bool "LG PHILIPS LB070WV6 LCD support"
	depends on FB_TCC

config LCD_CLAA104XA01CW
	bool "CPT CLAA104XA01CW LCD support"
	depends on FB_TCC

config LCD_HT121WX2
	bool "Hyundai-BOEhydis HT121WX2 LCD support"
	depends on FB_TCC

config LCD_TD043MGEB1
	bool "TPO TD043MGEB1 LCD support"
	depends on FB_TCC

config LCD_AT070TN93
	bool "INNOLUX AT070TN93 LCD support"
	depends on FB_TCC

config LCD_TD070RDH
	bool "SHANGHAI AVIC OPTOELECTRONICS TD070RDH LCD support"
	depends on FB_TCC


config LCD_HDMI1280X720
	bool "HDMI 1280x720 LCD support"
	depends on FB_TCC

config LCD_N101L6
	bool "CHI MED 1024x600 LCD support"
	depends on FB_TCC

config LCD_TW8816
	bool "TW8816 LCD support"
	depends on FB_TCC && (MACH_MOBIS)

config LCD_CLAA102NA0DCW
	bool "CPT 1024 * 600 LVDS support"
	depends on FB_TCC

config LCD_ED090NA
	bool "CPT 1024 * 600 LVDS support"
	depends on FB_TCC
endmenu
```
